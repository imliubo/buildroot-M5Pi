## board/IAMLIUBO/m5pi/uboot.defconfig
```kconfig
CONFIG_ARM=y
CONFIG_ARCH_SUNXI=y
CONFIG_MACH_SUNIV=y
CONFIG_DEFAULT_DEVICE_TREE="suniv-f1c100s-generic"

CONFIG_SYS_CLK_FREQ=408000000
CONFIG_DRAM_CLK=168
CONFIG_DRAM_ZQ=0

CONFIG_CONS_INDEX=1

CONFIG_SPL=y
CONFIG_SPL_SPI_SUNXI=y
CONFIG_MMC_SUNXI_SLOT_EXTRA=1

CONFIG_SYS_TEXT_BASE=0x81700000

CONFIG_ENV_IS_NOWHERE=y
CONFIG_ENV_IS_IN_FAT=n
CONFIG_USE_DEFAULT_ENV_FILE=y
CONFIG_DEFAULT_ENV_FILE="../../../board/IAMLIUBO/m5pi/uboot.env"

CONFIG_BOOTDELAY=0

CONFIG_NET=n

CONFIG_SPI=y
CONFIG_DM_SPI=y
CONFIG_SPI_SUNXI=y

CONFIG_PHY=y
CONFIG_PHY_SUN4I_USB=y

CONFIG_USB_MUSB_SUNXI=y
CONFIG_USB_MUSB_GADGET=y
CONFIG_USB_MUSB_PIO_ONLY=y
CONFIG_USB_MUSB_DISABLE_BULK_COMBINE_SPLIT=y
CONFIG_USB_GADGET_VBUS_DRAW=250

CONFIG_USB_STORAGE=y
CONFIG_CMD_USB_MASS_STORAGE=y

CONFIG_CMD_FASTBOOT=n
CONFIG_FASTBOOT=n
CONFIG_USB_FUNCTION_FASTBOOT=n

CONFIG_CMD_MTDPARTS=y

CONFIG_USB_GADGET_DOWNLOAD=y
```

## package/esp8089-spi/Config.in
```kconfig
config BR2_PACKAGE_ESP8089_SPI
	bool "ESP8089 Wi-Fi Chip"
	help
        Not yet.
```
